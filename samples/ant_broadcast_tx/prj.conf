## CMakeLists.txt
```
#
# Copyright (c) 2022 Garmin Canada Inc.
#
cmake_minimum_required(VERSION 3.20.0)

find_package(Zephyr REQUIRED HINTS $ENV{ZEPHYR_BASE})
project(NONE)

# NORDIC SDK APP START
target_sources(app PRIVATE
  src/main.c
)
# NORDIC SDK APP END
zephyr_library_include_directories(.)
```

## Kconfig
```
#
# Copyright 2022 by Garmin Ltd. or its subsidiaries.
# All rights reserved.
#
# Use of this Software is limited and subject to the License Agreement for ANT SoftDevice
# and Associated Software. The Agreement accompanies the Software in the root directory of
# the repository.
#

source "Kconfig.zephyr"

menuconfig BROADCAST_TX
	bool "ANT Broadcast TX sample"
	select ANT
	select ANT_CHANNEL_CONFIG
	select ANT_STATE_INDICATOR
	select DK_LIBRARY
	default y

menu "Channel configuration"

config BROADCAST_TX_CHANNEL_NUM
	int "Channel number"
	default 0

config BROADCAST_TX_NETWORK_NUM
	int "Network number"
	default 0

config BROADCAST_TX_CHAN_ID_DEV_NUM
	int "Channel ID: Device number"
	default 2
	range 0 65535

config BROADCAST_TX_CHAN_ID_DEV_TYPE
	int "Channel ID: Device type"
	default 2
	range 0 127

config BROADCAST_TX_CHAN_ID_TRANS_TYPE
	int "Channel ID: Transmission type"
	default 1
	range 0 255

config BROADCAST_TX_CHAN_PERIOD
	int "Channel Period"
	default 8192
	range 0 65535

config BROADCAST_TX_RF_FREQ
	int "Radio Frequency"
	default 66

endmenu
```

## sample.yaml
```
sample:
  description: ANT Broadcast Transmitter Sample
  name: ANT Broadcast Transmitter
tests:
  sample.ant_broadcast_tx.dual_core:
    sysbuild: true
    platform_allow: nrf5340dk/nrf5340/cpuapp
    integration_platforms:
      - nrf5340dk/nrf5340/cpuapp
    tags: ant
    build_only: true
    extra_args: ant_rpc_CONFIG_ANT_EVALUATION_KEY=y
  sample.ant_broadcast_tx.single_core:
    sysbuild: true
    platform_allow:
      - nrf52840dk/nrf52840
      - nrf52dk/nrf52832
      - nrf54l15dk/nrf54l05/cpuapp
      - nrf54l15dk/nrf54l10/cpuapp
      - nrf54l15dk/nrf54l15/cpuapp
      - nrf54lm20dk/nrf54lm20a/cpuapp
    integration_platforms:
      - nrf52840dk/nrf52840
      - nrf52dk/nrf52832
      - nrf54l15dk/nrf54l05/cpuapp
      - nrf54l15dk/nrf54l10/cpuapp
      - nrf54l15dk/nrf54l15/cpuapp
      - nrf54lm20dk/nrf54lm20a/cpuapp
    tags: ant
    build_only: true
    extra_args: CONFIG_ANT_EVALUATION_KEY=y
```

## prj.conf
```kconfig
#
# Copyright 2023 by Garmin Ltd. or its subsidiaries.
# All rights reserved.
#
# Use of this Software is limited and subject to the License Agreement for ANT SoftDevice
# and Associated Software. The Agreement accompanies the Software in the root directory of
# the repository.
#

CONFIG_ANT=y
# Evaluation key for ANT
# Set this Kconfig to use the evaluation stack for SINGLE CORE builds (for example, nRF52 Series).
# You MUST obtain a valid commercial license key BEFORE releasing a product to market that uses ANT.
# For more information about licensing please see CONFIG_ANT_LICENSE_KEY and visit the website below:
# https://developer.garmin.com/ant-program/licensing/
CONFIG_ANT_EVALUATION_KEY=n

CONFIG_NCS_SAMPLES_DEFAULTS=y
CONFIG_LOG=y
CONFIG_LOG_MODE_DEFERRED=y

CONFIG_HEAP_MEM_POOL_SIZE=4096
CONFIG_RESET_ON_FATAL_ERROR=n
```

## src/main.c
```c
/**
 * This software is subject to the ANT+ Shared Source License
 * https://developer.garmin.com/ant-program/licensing/shared-source-license/
 * Copyright (c) Garmin Canada Inc. 2022
 * All rights reserved.
 *
 * Redistribution and use in source and binary forms, with or
 * without modification, are permitted provided that the following
 * conditions are met:
 *
 *    1) Redistributions of source code must retain the above
 *       copyright notice, this list of conditions and the following
 *       disclaimer.
 *
 *    2) Redistributions in binary form must reproduce the above
 *       copyright notice, this list of conditions and the following
 *       disclaimer in the documentation and/or other materials
 *       provided with the distribution.
 *
 *    3) Neither the name of Garmin nor the names of its
 *       contributors may be used to endorse or promote products
 *       derived from this software without specific prior
 *       written permission.
 *
 * The following actions are prohibited:
 *
 *    1) Redistribution of source code containing the ANT+ Network
 *       Key.
 *
 *    2) Reverse engineering, decompilation, and/or disassembly of
 *       software provided in binary form under this license.
 *
 * THIS SOFTWARE IS PROVIDED BY THE COPYRIGHT HOLDERS AND
 * CONTRIBUTORS "AS IS" AND ANY EXPRESS OR IMPLIED WARRANTIES,
 * INCLUDING, BUT NOT LIMITED TO, THE IMPLIED WARRANTIES OF
 * MERCHANTABILITY AND FITNESS FOR A PARTICULAR PURPOSE ARE HEREBY
 * DISCLAIMED. IN NO EVENT SHALL THE COPYRIGHT HOLDER OR
 * CONTRIBUTORS BE LIABLE FOR ANY DIRECT, INDIRECT, INCIDENTAL,
 * SPECIAL, EXEMPLARY, OR CONSEQUENTIAL DAMAGES(INCLUDING,
 * BUT NOT LIMITED TO, PROCUREMENT OF SUBSTITUTE GOODS OR
 * SERVICES; DAMAGE TO ANY DEVICE, LOSS OF USE, DATA, OR
 * PROFITS; OR BUSINESS INTERRUPTION) HOWEVER CAUSED AND ON
 * ANY THEORY OF LIABILITY, WHETHER IN CONTRACT, STRICT LIABILITY,
 * OR TORT (INCLUDING NEGLIGENCE OR OTHERWISE) ARISING IN
 * ANY WAY OUT OF THE USE OF THIS SOFTWARE, EVEN IF ADVISED
 * OF THE POSSIBILITY OF SUCH DAMAGE. SOME STATES DO NOT ALLOW
 * THE EXCLUSION OF INCIDENTAL OR CONSEQUENTIAL DAMAGES, SO THE
 * ABOVE LIMITATIONS MAY NOT APPLY TO YOU.
 *
 */

#include <zephyr/kernel.h>
#include <zephyr/logging/log.h>

#include "ant_error.h"
#include "ant_interface.h"
#include "ant_parameters.h"
#include "ant_host_init.h"
#include "ant_channel_config.h"

LOG_MODULE_REGISTER(ant_broadcast_tx, LOG_LEVEL_INF);

/**@brief Function for setting payload for ANT message and sending it.
 */
void ant_message_send(void) {
  uint8_t message_payload[ANT_STANDARD_DATA_PAYLOAD_SIZE];
  static uint8_t counter = 1u;

  memset(message_payload, 0, ANT_STANDARD_DATA_PAYLOAD_SIZE);
  // Assign a new value to the broadcast data.
  message_payload[ANT_STANDARD_DATA_PAYLOAD_SIZE - 1] = counter;

  // Broadcast the data.
  ant_err_t err_code = ant_broadcast_message_tx(CONFIG_BROADCAST_TX_CHANNEL_NUM,
                                               ANT_STANDARD_DATA_PAYLOAD_SIZE, message_payload);
  if (err_code) {
    LOG_ERR("ant_broadcast_message_tx() failed: 0x%X", err_code);
  }

  counter++;
}

/**@brief Helper function for converting ANT message buffer to string.
 */
void convert_buf_to_hex_str(uint8_t* buf, uint8_t buf_size, char* hex_str) {
  // note: hex_str size is buf_size*3 + 1 to accommodate hex bytes string
  //       representation w/ spacing + null
  char* p_str = hex_str;
  for (uint8_t i = 0; i < buf_size; i++) {
    uint8_t upper = ((buf[i] >> 4) & 0x0F);
    uint8_t lower = ((buf[i] >> 0) & 0x0F);
    if (upper < 0x0A) {
      *p_str++ = upper + 0x30;
    } else {
      *p_str++ = upper - 0x0A + 0x41;
    }
    if (lower < 0x0A) {
      *p_str++ = lower + 0x30;
    } else {
      *p_str++ = lower - 0x0A + 0x41;
    }
    // space
    *p_str++ = 0x20;
  }
  // null terminate
  *p_str = '\0';
}

/**@brief Function for handling a ANT stack event.
 *
 * @param[in] p_ant_evt  ANT stack event.
 */
static void ant_evt_handler(ant_evt_t* p_ant_evt) {
  if (p_ant_evt->channel == CONFIG_BROADCAST_TX_CHANNEL_NUM) {
    // hex_str size: 2 digit hex representations + spaces + null termination
    char hex_str[MESG_BUFFER_SIZE * 3 + 1];

    if (p_ant_evt->event) {
      convert_buf_to_hex_str(p_ant_evt->message.ANT_MESSAGE_aucMessage,
                             p_ant_evt->message.ANT_MESSAGE_ucSize + MESG_SIZE_SIZE + MESG_ID_SIZE,
                             hex_str);
    }

    // print out applicable decoded events
    switch (p_ant_evt->event) {
      case EVENT_TX:
        LOG_INF("EVENT_TX - %s", hex_str);
        ant_message_send();
        break;
      case EVENT_RX_SEARCH_TIMEOUT:
        LOG_INF("EVENT_RX_SEARCH_TIMEOUT - %s", hex_str);
        break;
      case EVENT_RX_FAIL:
        LOG_INF("EVENT_RX_FAIL - %s", hex_str);
        break;
      case EVENT_TRANSFER_RX_FAILED:
        LOG_INF("EVENT_TRANSFER_RX_FAILED - %s", hex_str);
        break;
      case EVENT_TRANSFER_TX_COMPLETED:
        LOG_INF("EVENT_TRANSFER_TX_COMPLETED - %s", hex_str);
        break;
      case EVENT_TRANSFER_TX_FAILED:
        LOG_INF("EVENT_TRANSFER_TX_FAILED - %s", hex_str);
        break;
      case EVENT_CHANNEL_CLOSED:
        LOG_INF("EVENT_CHANNEL_CLOSED - %s", hex_str);
        break;
      case EVENT_RX_FAIL_GO_TO_SEARCH:
        LOG_INF("EVENT_RX_FAIL_GO_TO_SEARCH - %s", hex_str);
        break;
      case EVENT_CHANNEL_COLLISION:
        LOG_INF("EVENT_CHANNEL_COLLISION - %s", hex_str);
        break;
      case EVENT_TRANSFER_TX_START:
        LOG_INF("EVENT_TRANSFER_TX_START - %s", hex_str);
        break;
      case EVENT_TRANSFER_NEXT_DATA_BLOCK:
        LOG_INF("EVENT_TRANSFER_NEXT_DATA_BLOCK - %s", hex_str);
        break;
      case EVENT_RX:
        LOG_INF("EVENT_RX - %s", hex_str);
        break;

      default:
        LOG_INF("%s", hex_str);
        break;
    }
  }
}

/**@brief Function for ANT stack initialization.
 */
ant_err_t ant_stack_setup(void) {
  ant_err_t err_code;

  err_code = ant_init();
  if (err_code == 0) {
    LOG_INF("ANT Version %s", ANT_VERSION_STRING);
  } else {
    LOG_ERR("ant_init failed: 0x%X", err_code);
    return err_code;
  }

  err_code = ant_cb_register(&ant_evt_handler);
  if (err_code) {
    LOG_ERR("ant_cb_register() failed: 0x%X", err_code);
  }

  return err_code;
}

/**@brief Function for setting up the ANT module to be ready for TX broadcast.
 */
static ant_err_t ant_channel_tx_broadcast_setup(void) {
  ant_channel_config_t broadcast_channel_config = {
      .channel_number     = CONFIG_BROADCAST_TX_CHANNEL_NUM,
      .channel_type       = CHANNEL_TYPE_MASTER,
      .ext_assign         = 0x00,
      .rf_freq            = CONFIG_BROADCAST_TX_RF_FREQ,
      .transmission_type  = CONFIG_BROADCAST_TX_CHAN_ID_TRANS_TYPE,
      .device_type        = CONFIG_BROADCAST_TX_CHAN_ID_DEV_TYPE,
      .device_number      = CONFIG_BROADCAST_TX_CHAN_ID_DEV_NUM,
      .channel_period     = CONFIG_BROADCAST_TX_CHAN_PERIOD,
      .network_number     = CONFIG_BROADCAST_TX_NETWORK_NUM,
  };

  ant_err_t err_code = ant_channel_init(&broadcast_channel_config);
  if (err_code) {
    LOG_ERR("ant_channel_init() failed: 0x%X", err_code);
    return err_code;
  }

  // Fill tx buffer for the first frame.
  ant_message_send();

  // Open channel.
  err_code = ant_channel_open(CONFIG_BROADCAST_TX_CHANNEL_NUM);
  if (err_code) {
    LOG_ERR("ant_channel_open() failed: 0x%X", err_code);
    return err_code;
  }

  return 0;
}

int main(void) {
  ant_err_t err_code;

  err_code = ant_stack_setup();
  if (err_code) {
    LOG_ERR("ant_stack_setup() failed: 0x%X", err_code);
    goto ERROR_EXIT;
  }

  err_code = ant_channel_tx_broadcast_setup();
  if (err_code) {
    goto ERROR_EXIT;
  }

  LOG_INF("ANT Broadcast TX example started");

  return 0;

ERROR_EXIT:
  k_oops();

  return 0;
}
```

## src/ant_config.h
```c
/**
 * This software is subject to the ANT+ Shared Source License
 * www.thisisant.com/swlicenses
 * Copyright (c) Garmin Canada Inc. 2022
 * All rights reserved.
 *
 * Redistribution and use in source and binary forms, with or
 * without modification, are permitted provided that the following
 * conditions are met:
 *
 *    1) Redistributions of source code must retain the above
 *       copyright notice, this list of conditions and the following
 *       disclaimer.
 *
 *    2) Redistributions in binary form must reproduce the above
 *       copyright notice, this list of conditions and the following
 *       disclaimer in the documentation and/or other materials
 *       provided with the distribution.
 *
 *    3) Neither the name of Garmin nor the names of its
 *       contributors may be used to endorse or promote products
 *       derived from this software without specific prior
 *       written permission.
 *
 * The following actions are prohibited:
 *
 *    1) Redistribution of source code containing the ANT+ Network
 *       Key. The ANT+ Network Key is available to ANT+ Adopters.
 *       Please refer to http://thisisant.com to become an ANT+
 *       Adopter and access the key.
 *
 *    2) Reverse engineering, decompilation, and/or disassembly of
 *       software provided in binary form under this license.
 *
 * THIS SOFTWARE IS PROVIDED BY THE COPYRIGHT HOLDERS AND
 * CONTRIBUTORS "AS IS" AND ANY EXPRESS OR IMPLIED WARRANTIES,
 * INCLUDING, BUT NOT LIMITED TO, THE IMPLIED WARRANTIES OF
 * MERCHANTABILITY AND FITNESS FOR A PARTICULAR PURPOSE ARE HEREBY
 * DISCLAIMED. IN NO EVENT SHALL THE COPYRIGHT HOLDER OR
 * CONTRIBUTORS BE LIABLE FOR ANY DIRECT, INDIRECT, INCIDENTAL,
 * SPECIAL, EXEMPLARY, OR CONSEQUENTIAL DAMAGES(INCLUDING,
 * BUT NOT LIMITED TO, PROCUREMENT OF SUBSTITUTE GOODS OR
 * SERVICES; DAMAGE TO ANY DEVICE, LOSS OF USE, DATA, OR
 * PROFITS; OR BUSINESS INTERRUPTION) HOWEVER CAUSED AND ON
 * ANY THEORY OF LIABILITY, WHETHER IN CONTRACT, STRICT LIABILITY,
 * OR TORT (INCLUDING NEGLIGENCE OR OTHERWISE) ARISING IN
 * ANY WAY OUT OF THE USE OF THIS SOFTWARE, EVEN IF ADVISED
 * OF THE POSSIBILITY OF SUCH DAMAGE. SOME STATES DO NOT ALLOW
 * THE EXCLUSION OF INCIDENTAL OR CONSEQUENTIAL DAMAGES, SO THE
 * ABOVE LIMITATIONS MAY NOT APPLY TO YOU.
 *
 */

/* Network number. */
#ifndef ANT_NETWORK_NUM
#define ANT_NETWORK_NUM 0
#endif

/* Broadcast channel number. */
#ifndef BROADCAST_CHANNEL_NUMBER
#define BROADCAST_CHANNEL_NUMBER 0
#endif

/* Channel ID: Device Number. */
#ifndef CHAN_ID_DEV_NUM
#define CHAN_ID_DEV_NUM 2
#endif

/* Channel ID: Device Type. */
#ifndef CHAN_ID_DEV_TYPE
#define CHAN_ID_DEV_TYPE 2
#endif

/* Channel ID: Transmission type. */
#ifndef CHAN_ID_TRANS_TYPE
#define CHAN_ID_TRANS_TYPE 1
#endif

/* Channel Period (in 32 kHz counts). */
#ifndef CHAN_PERIOD
#define CHAN_PERIOD 8192
#endif

/* RF Frequency. */
#ifndef RF_FREQ
#define RF_FREQ 66
#endif
```
