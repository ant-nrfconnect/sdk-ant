## init/Kconfig
```kconfig
#
# Copyright 2023 by Garmin Ltd. or its subsidiaries.
# All rights reserved.
#
# Use of this Software is limited and subject to the License Agreement for ANT SoftDevice
# and Associated Software. The Agreement accompanies the Software in the root directory of
# the repository.
#

config ANT_LICENSE_KEY
	string "ANT License Key."
	depends on ANT_LIBRARY_CORE
	default "3831-521d-7df9-24d8-eff3-467b-225f-a00e" if ANT_EVALUATION_KEY
	help
		This key is used in library initialization. You MUST obtain a
		valid commercial license key BEFORE releasing a product to market
		that uses ANT. You may enable the Evaluation license key for
		non-commericial use by setting CONFIG ANT_EVALUATION_KEY=y or
		defining CONFIG_ANT_LICENSE_KEY in the configuration file. For
		more information about ANT licensing, visit the following website:
		https://www.thisisant.com/developer/ant/licensing

config ANT_EVALUATION_KEY
	bool "Use ANT Evaluation License Key."
	depends on ANT_LIBRARY_CORE
	default n

config ANT_THREAD_COOP_PRIO
	int
	default 8

config ANT_WORK_STACK_SIZE
	int "Size of the work handler thread stack."
	default 1024
	help
	  Size of the work handler thread stack, used to process work in ANT priority context.

choice ANT_SWI
	default ANT_SWI1
	prompt "Software interrupt to use for ANT events."

config ANT_SWI1
	bool "SWI1"
	depends on HAS_HW_NRF_SWI1 || SOC_SERIES_NRF54LX

config ANT_SWI2
	bool "SWI2"
	depends on HAS_HW_NRF_SWI2 || SOC_SERIES_NRF54LX

config ANT_SWI3
	bool "SWI3"
	depends on HAS_HW_NRF_SWI3 || SOC_SERIES_NRF54LX

endchoice

config ANT_TOTAL_CHANNELS_ALLOCATED
	int
	range 1 15
	default 15
	prompt "Allocated ANT channels."

config ANT_ENCRYPTED_CHANNELS
	int
	default 0
	prompt "Allocated ANT encrypted channels."

config ANT_EVENT_QUEUE_SIZE
	int
	default 32
	prompt "Event queue size."

config ANT_BURST_QUEUE_SIZE
	int
	default 128
	prompt "ANT burst queue size."

config ANT_SDC_INIT
	bool "Allow ANT Init to initialize the Softdevice Controller (sdc_init)"
	depends on BT
	depends on ANT_LIBRARY_CORE
	default n
	help
	  Allow ANT initialization on the network core to also initialize the softdevice
	  controller. This is to allow the ANT library stack to utlize the sdc_soc
	  interface for cryptographic purposes. If sdc_init() is run prior to ANT
	  initialization (eg. for BT), then this configuration is not needed as long as
	  it is run before using any ANT library stack cryptographic functions.

module=ANT
module-str=ANT
source "${ZEPHYR_BASE}/subsys/logging/Kconfig.template.log_config"
```

## np/Kconfig
```kconfig
#
# Copyright 2023 by Garmin Ltd. or its subsidiaries.
# All rights reserved.
#
# Use of this Software is limited and subject to the License Agreement for ANT SoftDevice
# and Associated Software. The Agreement accompanies the Software in the root directory of
# the repository.
#

config ANT_NP
    bool "ANT Network Processor Multicore API Serialization"
    depends on ANT
    select ANT_NP_HOST if SOC_NRF5340_CPUAPP
    select ANT_NP_REMOTE if SOC_NRF5340_CPUNET
    select ANT_RPC
    default y if SOC_NRF5340_CPUAPP || SOC_NRF5340_CPUNET
    default n
    help
       Serialize API calls for execution on remote CPU. 

config ANT_NP_HOST
    bool "ANT Network Processor Host (cpuapp)"
    depends on ANT_NP
    depends on SOC_NRF5340_CPUAPP
    default n
    help
       ANT Host (application core) configuration for multicore applications.

config ANT_NP_REMOTE
    bool "ANT Network Processor Remote (cpunet)"
    depends on ANT_NP
    depends on SOC_NRF5340_CPUNET
    default n
    help
       ANT Remote (network core) configuration for multicore applications.

config ANT_RPC
    bool "ANT over RPC"
    default n
    select NRF_RPC

config ANT_NP_HOST_SYS_INIT
    bool "Initialize ANT network processor host during SYS_INIT"
    depends on ANT_NP_HOST
    default y
    help
       In most cases, the network processor host module handles initialization using
       the SYS_INIT macro. This Kconfig is provided to bypass initialization and expose
       the ant_rpc_app_init function for applications that have unique initialization
       requirements. When enabled, it becomes the responisbility of the application to
       ensure that ant_init() is called on the application core prior to any ANT API usage
       so RPC messages from the network core can be processed.
```

## samples/ant_background_scanning/sample.yaml
```yaml
sample:
  description: ANT Background Scanning Sample
  name: ANT Background Scanning
tests:
  sample.ant_background_scanning.dual_core:
    platform_allow: nrf5340dk_nrf5340_cpuapp
    tags: ant
    build_only: true
    extra_args: ant_rpc_CONFIG_ANT_EVALUATION_KEY=y
  sample.ant_background_scanning.single_core:
    platform_allow: nrf52840dk_nrf52840
    integration_platforms:
      - nrf52840dk_nrf52840
    tags: ant
    build_only: true
    extra_args: CONFIG_ANT_EVALUATION_KEY=y
```

## samples/ant_plus/ant_bsc/bsc_rx/sample.yaml
```yaml
sample:
  description: ANT+ Bicycle Speed and Cadence Receiver Sample
  name: ANT+ Bicycle Speed and Cadence Receiver
tests:
  sample.bsc_rx.dual_core:
    platform_allow: nrf5340dk_nrf5340_cpuapp
    integration_platforms:
      - nrf5340dk_nrf5340_cpuapp
    tags: ant
    build_only: true
    extra_args: ant_rpc_CONFIG_ANT_EVALUATION_KEY=y
  sample.bsc_rx.single_core:
    platform_allow: nrf52840dk_nrf52840
    integration_platforms:
      - nrf52840dk_nrf52840
    tags: ant
    build_only: true
    extra_args: CONFIG_ANT_EVALUATION_KEY=y
```

## samples/ant_rpc/sample.yaml
```yaml
sample:
  description: Provides ANT connectivity over RPC
  name: ANT RPC
tests:
  sample.ant_rpc:
    sysbuild: true
    platform_allow: nrf5340dk/nrf5340/cpunet
    integration_platforms:
      - nrf5340dk/nrf5340/cpunet
    tags: ant
    build_only: true
    extra_configs:
      - CONFIG_ANT_EVALUATION_KEY=y
```
